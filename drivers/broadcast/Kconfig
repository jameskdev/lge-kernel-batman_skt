## drivers/broadcast/Kconfig
```kconfig
#
# Broadcast Device Driver Support
#

#menu "BROADCAST_DEVICE"

config LGE_BROADCAST_TDMB
	bool "LGE broacast device"
	default n
	depends on (MACH_LGE_325_BOARD_SKT || MACH_LGE_325_BOARD_LGU)
	help
	  Select this if you want to use broadcast service
	  
#endmenu
```

## lge/com_device/broadcast/Kconfig
```kconfig
#
# Broadcast Device Driver Support
#

menu "BROADCAST_DEVICE"

config LGE_BROADCAST_DCM
	bool "LGE broacast device"
	default n
	depends on MACH_LGE_325_BOARD_DCM
	help
	  Select this if you want to use broadcast service
	  
endmenu
```
